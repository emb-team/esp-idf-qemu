## examples/bluetooth/ble_mesh/ble_mesh_console/ble_mesh_provisioner/sdkconfig.defaults
```kconfig
# Override some defaults so BT stack is enabled
# by default in this example
CONFIG_BT_ENABLED=y
CONFIG_BLE_SCAN_DUPLICATE=y
CONFIG_SCAN_DUPLICATE_TYPE=2
CONFIG_DUPLICATE_SCAN_CACHE_SIZE=200
CONFIG_BLE_MESH_SCAN_DUPLICATE_EN=y
CONFIG_MESH_DUPLICATE_SCAN_CACHE_SIZE=200
CONFIG_BLE_MESH=y
CONFIG_BLE_MESH_USE_DUPLICATE_SCAN=y
CONFIG_BLE_MESH_PROV=y
CONFIG_BLE_MESH_PROVISIONER=y
CONFIG_BLE_MESH_WAIT_FOR_PROV_MAX_DEV_NUM=20
CONFIG_BLE_MESH_MAX_PROV_NODES=20
CONFIG_BLE_MESH_PBA_SAME_TIME=10
CONFIG_BLE_MESH_PBG_SAME_TIME=4
CONFIG_BLE_MESH_PROVISIONER_SUBNET_COUNT=3
CONFIG_BLE_MESH_PROVISIONER_APP_KEY_COUNT=9
CONFIG_BLE_MESH_PB_ADV=y
CONFIG_BLE_MESH_NET_BUF_POOL_USAGE=y
CONFIG_BLE_MESH_PB_GATT=y
CONFIG_BLE_MESH_GATT_PROXY=y
CONFIG_BLE_MESH_RELAY=y
CONFIG_BLE_MESH_LOW_POWER=
CONFIG_BLE_MESH_FRIEND=
CONFIG_BTU_TASK_STACK_SIZE=4512
CONFIG_BLE_MESH_CFG_CLI=y
CONFIG_BLE_MESH_GENERIC_ONOFF_CLI=y
```

## examples/bluetooth/ble_mesh/ble_mesh_fast_provision/ble_mesh_fast_prov_client/main/Kconfig.projbuild
```kconfig
menu "Example Configuration"

    config HCI_5_0_VERSION
        bool "Support sending 20ms non-connectable advertising packets"
        default y
        help
            It is a temporary solution and needs further modifications.

endmenu
```

## examples/bluetooth/ble_mesh/ble_mesh_fast_provision/ble_mesh_fast_prov_client/sdkconfig.defaults
```kconfig
# Override some defaults so BT stack is enabled
# by default in this example
CONFIG_BT_ENABLED=y
CONFIG_BLE_SCAN_DUPLICATE=y
CONFIG_SCAN_DUPLICATE_TYPE=2
CONFIG_DUPLICATE_SCAN_CACHE_SIZE=200
CONFIG_BLE_MESH_SCAN_DUPLICATE_EN=y
CONFIG_MESH_DUPLICATE_SCAN_CACHE_SIZE=200
CONFIG_BT_MESH=y
CONFIG_BT_MESH_USE_DUPLICATE_SCAN=y
CONFIG_BT_MESH_PROV=y
CONFIG_BT_MESH_PROVISIONER=y
CONFIG_BT_MESH_UNPROV_DEV_ADD=10
CONFIG_BT_MESH_MAX_PROV_NODES=10
CONFIG_BT_MESH_MAX_STORED_NODES=10
CONFIG_BT_MESH_PBA_SAME_TIME=1
CONFIG_BT_MESH_PBG_SAME_TIME=1
CONFIG_BT_MESH_PROVISIONER_SUBNET_COUNT=3
CONFIG_BT_MESH_PROVISIONER_APP_KEY_COUNT=3
CONFIG_BT_MESH_PB_ADV=y
CONFIG_NET_BUF_POOL_USAGE=y
CONFIG_BT_MESH_PB_GATT=y
CONFIG_BT_MESH_GATT_PROXY=y
CONFIG_BT_MESH_RELAY=y
CONFIG_BT_MESH_LOW_POWER=
CONFIG_BT_MESH_FRIEND=
CONFIG_BTU_TASK_STACK_SIZE=4512
CONFIG_BT_MESH_CFG_CLI=y
CONFIG_BT_MESH_GENERIC_ONOFF_CLI=y
CONFIG_BT_MESH_ADV_BUF_COUNT=100
CONFIG_BT_MESH_CRPL=10
CONFIG_BT_MESH_TX_SEG_MSG_COUNT=10
CONFIG_BT_MESH_RX_SEG_MSG_COUNT=10
CONFIG_BT_MESH_NO_LOG=n
CONFIG_BT_MESH_STACK_INITIAL_TRACE_LEVEL=1
```

## examples/bluetooth/ble_mesh/ble_mesh_fast_provision/ble_mesh_fast_prov_server/main/Kconfig.projbuild
```kconfig
menu "Example Configuration"

    choice ESP32_BOARD
        prompt "Board selection for BLE Mesh"
        default ESP_WROOM_32_BOARD
        help
            Select this option to choose the board for BLE Mesh. The default is ESP32-WROOM-32

        config ESP_WROOM_32_BOARD
            bool "ESP32-WROOM-32"

        config ESP_WROVER_BOARD
            bool "ESP32-WROVER"
    endchoice

    config HCI_5_0_VERSION
        bool "Support sending 20ms non-connectable advertising packets"
        default y
        help
            It is a temporary solution and needs further modifications.

endmenu
```

## examples/bluetooth/ble_mesh/ble_mesh_node/main/Kconfig.projbuild
```kconfig
menu "Example Configuration"

    choice ESP32_BOARD
        prompt "Board selection for BLE Mesh"
        default ESP_WROOM_32_BOARD
        help
            Select this option to choose the board for BLE Mesh. The default is ESP32-WROOM-32

        config ESP_WROOM_32_BOARD
            bool "ESP32-WROOM-32"

        config ESP_WROVER_BOARD
            bool "ESP32-WROVER"
    endchoice

    config HCI_5_0_VERSION
        bool "Support sending 20ms non-connectable advertising packets"
        default y
        help
            It is a temporary solution and needs further modifications.

    config PATCH_FOR_SILICONLAB_APP_1_1_0
        bool "Fix bug of Silicon Lab Android App v1.1.0 when reconnection will cause sequence number to recount from 0"
        default y
        help
            It is an ad hoc solution and needs further modifications

endmenu
```

## examples/bluetooth/ble_mesh/ble_mesh_provisioner/sdkconfig.defaults
```kconfig
# Override some defaults so BT stack is enabled
# by default in this example
CONFIG_BT_ENABLED=y
CONFIG_BT_MESH=y
CONFIG_BT_MESH_PROV=y
CONFIG_BT_MESH_PROVISIONER=y
CONFIG_BT_MESH_UNPROV_DEV_ADD=10
CONFIG_BT_MESH_MAX_STORED_NODES=10
CONFIG_BT_MESH_MAX_PROV_NODES=10
CONFIG_BT_MESH_PBA_SAME_TIME=3
CONFIG_BT_MESH_PBG_SAME_TIME=2
CONFIG_BT_MESH_PROVISIONER_SUBNET_COUNT=3
CONFIG_BT_MESH_PROVISIONER_APP_KEY_COUNT=3
CONFIG_BT_MESH_PB_ADV=y
CONFIG_NET_BUF_POOL_USAGE=y
CONFIG_BT_MESH_PB_GATT=y
CONFIG_BT_MESH_GATT_PROXY=y
CONFIG_BT_MESH_RELAY=y
CONFIG_BT_MESH_LOW_POWER=
CONFIG_BT_MESH_FRIEND=
CONFIG_BT_MESH_TX_SEG_MSG_COUNT=6
CONFIG_BT_MESH_RX_SEG_MSG_COUNT=6
CONFIG_BTU_TASK_STACK_SIZE=4512
CONFIG_BT_MESH_CFG_CLI=y
CONFIG_BT_MESH_HEALTH_CLI=y
CONFIG_BT_MESH_GENERIC_ONOFF_CLI=y
```

## examples/bluetooth/ble_mesh/ble_mesh_wifi_coexist/main/Kconfig.projbuild
```kconfig
menu "Example 'BLE Mesh' Config"

choice ESP32_BOARD
    prompt "Board selection for BLE Mesh"
    default ESP_WROOM_32_BOARD
    help
        Select this option to choose the board for BLE Mesh. The default is ESP32-WROOM-32

config ESP_WROOM_32_BOARD
    bool "ESP32-WROOM-32"

config ESP_WROVER_BOARD
    bool "ESP32-WROVER"

endchoice

config HCI_5_0_VERSION
    bool "If you need to send 20ms non-connectable advertising packets and the BLE controller you are using is not HCI 5.0, set this marco to true."
    default y
    help
         It is just a temporary solution, which will be modified later.

endmenu
```

## examples/bluetooth/ble_mesh/ble_mesh_wifi_coexist/sdkconfig.defaults
```kconfig
# Override some defaults so BT stack is enabled
# by default in this example

CONFIG_ESP32_DEFAULT_CPU_FREQ_240=y
CONFIG_ESP32_DEFAULT_CPU_FREQ_MHZ=240
CONFIG_MEMMAP_SMP=y
CONFIG_BT_ENABLED=y
CONFIG_BT_MESH=y
CONFIG_BT_MESH_FAST_PROV=y
CONFIG_BT_MESH_PROV=y
CONFIG_BT_MESH_NODE=y
CONFIG_BT_MESH_PROVISIONER=y
CONFIG_BT_MESH_UNPROV_DEV_ADD=20
CONFIG_BT_MESH_MAX_STORED_NODES=10
CONFIG_BT_MESH_MAX_PROV_NODES=6
CONFIG_BT_MESH_PBA_SAME_TIME=3
CONFIG_BT_MESH_PBG_SAME_TIME=3
CONFIG_BT_MESH_PROVISIONER_SUBNET_COUNT=3
CONFIG_BT_MESH_PROVISIONER_APP_KEY_COUNT=9
CONFIG_BT_MESH_PB_ADV=y
CONFIG_NET_BUF_POOL_USAGE=y
CONFIG_BT_MESH_PB_GATT=y
CONFIG_BT_MESH_GATT_PROXY=y
CONFIG_BT_MESH_RELAY=y
CONFIG_BT_MESH_LOW_POWER=
CONFIG_BT_MESH_FRIEND=
CONFIG_BTU_TASK_STACK_SIZE=4512
CONFIG_BT_MESH_CFG_CLI=y
CONFIG_BT_MESH_GENERIC_ONOFF_CLI=y
CONFIG_BT_MESH_CRPL=60
CONFIG_BT_MESH_MSG_CACHE_SIZE=60
CONFIG_BT_MESH_ADV_BUF_COUNT=200
CONFIG_BT_MESH_TX_SEG_MSG_COUNT=10
CONFIG_BT_MESH_RX_SEG_MSG_COUNT=10
CONFIG_BT_MESH_NO_LOG=n
CONFIG_BT_MESH_STACK_INITIAL_TRACE_LEVEL=0

CONFIG_SYSTEM_EVENT_TASK_STACK_SIZE=4096

CONFIG_ESP32_WIFI_STATIC_RX_BUFFER_NUM=16
CONFIG_ESP32_WIFI_DYNAMIC_RX_BUFFER_NUM=64
CONFIG_ESP32_WIFI_DYNAMIC_TX_BUFFER_NUM=64
CONFIG_ESP32_WIFI_AMPDU_TX_ENABLED=y
CONFIG_ESP32_WIFI_TX_BA_WIN=32
CONFIG_ESP32_WIFI_AMPDU_RX_ENABLED=y
CONFIG_ESP32_WIFI_RX_BA_WIN=32

CONFIG_FREERTOS_UNICORE=
CONFIG_FREERTOS_HZ=1000

CONFIG_INT_WDT=
CONFIG_TASK_WDT=

CONFIG_TCP_SND_BUF_DEFAULT=65535
CONFIG_TCP_WND_DEFAULT=65535
CONFIG_TCP_RECVMBOX_SIZE=64
CONFIG_UDP_RECVMBOX_SIZE=64
CONFIG_TCPIP_RECVMBOX_SIZE=64
CONFIG_LWIP_ETHARP_TRUST_IP_MAC=

CONFIG_FLASHMODE_QIO=y
CONFIG_ESPTOOLPY_FLASHFREQ_40M=y
CONFIG_LWIP_IRAM_OPTIMIZATION=y

CONFIG_PARTITION_TABLE_CUSTOM=y
CONFIG_ESPTOOLPY_FLASHSIZE_4MB=y
```
